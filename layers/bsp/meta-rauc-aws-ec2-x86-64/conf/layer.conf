## layers/bsp/meta-rauc-aws-ec2-x86-64/conf/layer.conf
```bitbake
# We have a conf and classes directory, add to BBPATH
BBPATH .= ":${LAYERDIR}"

# We have recipes-* directories, add to BBFILES
BBFILES += "${LAYERDIR}/recipes-*/*/*.bb \
            ${LAYERDIR}/recipes-*/*/*.bbappend"

BBFILE_COLLECTIONS += "meta-rauc-aws-ec2-x86-64"
BBFILE_PATTERN_meta-rauc-aws-ec2-x86-64= "^${LAYERDIR}/"
BBFILE_PRIORITY_meta-rauc-aws-ec2-x86-64 = "6"

LAYERDEPENDS_meta-rauc-aws-ec2-x86-64 = "core"
LAYERSERIES_COMPAT_meta-rauc-aws-ec2-x86-64 = "scarthgap"
```
